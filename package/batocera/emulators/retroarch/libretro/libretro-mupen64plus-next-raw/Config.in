## package/batocera/emulators/retroarch/libretro/libretro-mupen64plus-next-raw/Config.in
```kconfig
config BR2_PACKAGE_LIBRETRO_MUPEN64PLUS_NEXT_RAW
	bool "libretro-mupen64plus-next-raw"
	depends on BR2_PACKAGE_RETROARCH

	help
	  A alternative libretro N64 emulator core, modified for raphnet adapters
```
